## sdkconfig.defaults.esp32c6
```kconfig
CONFIG_ESPTOOLPY_FLASHSIZE_16MB=y
CONFIG_PARTITION_TABLE_CUSTOM_FILENAME="partitions/v2/16m_c3.csv"
CONFIG_ESPTOOLPY_FLASHMODE_QIO=y

CONFIG_SR_WN_WN9S_NIHAOXIAOZHI=y

# ESP-ADF 修正 FreeRTOS 相容性編譯
CONFIG_FREERTOS_ENABLE_BACKWARD_COMPATIBILITY=y

# 預設聊天風格
CONFIG_USE_DEFAULT_MESSAGE_STYLE=y

# SD 卡
CONFIG_FATFS_API_ENCODING_UTF_8=y
CONFIG_FATFS_LFN_HEAP=yｓ
```
